// SPDX-License-Identifier: GPL-2.0-only OR MIT
/*
 * FiberHome HG5580A -- stock partition layout.
 *
 * Hardware nodes are in an7583-fiberhome-hg5580a-common.dtsi; only the
 * partition table differs between the stock and UBI variants.
 *
 * Pairs with the vendor U-Boot 2023.04 whose ldkernel boots a FIT from
 * KernelB and root= /dev/mtdblock5 on RootfsB.
 */

#include "an7583-fiberhome-hg5580a-common.dtsi"
#include "an758x-fiberhome-hg5580a-stock-parts.dtsi"
